/* USER CODE BEGIN Header */
/**
  ******************************************************************************
  * @file           : main.c
  * @brief          : Main program body
  ******************************************************************************
  * @attention
  *
  * Copyright (c) 2024 STMicroelectronics.
  * All rights reserved.
  *
  * This software is licensed under terms that can be found in the LICENSE file
  * in the root directory of this software component.
  * If no LICENSE file comes with this software, it is provided AS-IS.
  *
  ******************************************************************************
  */
/* USER CODE END Header */
/* Includes ------------------------------------------------------------------*/
#include "main.h"

/* Private includes ----------------------------------------------------------*/
/* USER CODE BEGIN Includes */
#include "fonts.h"
#include "ssd1306.h"
/* USER CODE END Includes */

/* Private typedef -----------------------------------------------------------*/
/* USER CODE BEGIN PTD */

/* USER CODE END PTD */

/* Private define ------------------------------------------------------------*/
/* USER CODE BEGIN PD */

/* USER CODE END PD */

/* Private macro -------------------------------------------------------------*/
/* USER CODE BEGIN PM */

/* USER CODE END PM */

/* Private variables ---------------------------------------------------------*/
I2C_HandleTypeDef hi2c1;

/* USER CODE BEGIN PV */

/* USER CODE END PV */

/* Private function prototypes -----------------------------------------------*/
void SystemClock_Config(void);
static void MX_GPIO_Init(void);
static void MX_I2C1_Init(void);
/* USER CODE BEGIN PFP */

/* USER CODE END PFP */

/* Private user code ---------------------------------------------------------*/
/* USER CODE BEGIN 0 */
// 'icons8-calendar-22', 22x22px
const unsigned char epd_bitmap_icons8_calendar_22 [] = {
	0xf9, 0xfe, 0x7c, 0xf5, 0xfe, 0xbc, 0x84, 0x00, 0x84, 0x80, 0x00, 0x04, 0x80, 0x00, 0x04, 0x80, 
	0x00, 0x04, 0xff, 0xff, 0xfc, 0x80, 0x00, 0x04, 0x80, 0x00, 0x04, 0x86, 0x49, 0x84, 0x86, 0xfd, 
	0x84, 0x80, 0x00, 0x04, 0x82, 0x49, 0x04, 0x86, 0xfd, 0x84, 0x82, 0x49, 0x04, 0x82, 0x49, 0x04, 
	0x86, 0xfd, 0x84, 0x82, 0x49, 0x04, 0x80, 0x00, 0x04, 0x80, 0x00, 0x04, 0x80, 0x00, 0x04, 0xff, 
	0xff, 0xfc
};
// 'icons8-time-20', 20x20px
// 'icons8-time-20 (1)', 20x20px
const unsigned char epd_bitmap_icons8_time_20__1_ []= {
	0xff, 0xff, 0xf0, 0xff, 0xff, 0xf0, 0xff, 0x0f, 0xf0, 0xff, 0x9f, 0xf0, 0xfe, 0x07, 0xf0, 0xfc, 
	0x01, 0xf0, 0xf8, 0x01, 0xf0, 0xf1, 0x00, 0xf0, 0xf1, 0x80, 0xf0, 0xe0, 0xc0, 0x70, 0xe0, 0x60, 
	0x70, 0xe0, 0x20, 0x70, 0xf0, 0x00, 0xf0, 0xf0, 0x00, 0xf0, 0xf8, 0x01, 0xf0, 0xfc, 0x03, 0xf0, 
	0xfe, 0x07, 0xf0, 0xff, 0xff, 0xf0, 0xff, 0xff, 0xf0, 0xff, 0xff, 0xf0
};
// 'icons8-high-temperatures-64', 64x64px
const unsigned char epd_bitmap_icons8_high_temperatures_64 []  = {
	0x00, 0x00, 0x00, 0x00, 0x00, 0x00, 0x00, 0x00, 0x00, 0x00, 0x00, 0x03, 0xc0, 0x00, 0x00, 0x00, 
	0x00, 0x00, 0x00, 0x0f, 0xf0, 0x00, 0x00, 0x00, 0x00, 0x00, 0x00, 0x1f, 0xf8, 0x00, 0x00, 0x00, 
	0x00, 0x00, 0x00, 0x1f, 0xf8, 0x00, 0x00, 0x00, 0x00, 0x00, 0x00, 0x3f, 0xfc, 0x00, 0x00, 0x00, 
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	0x00, 0x00, 0x00, 0x07, 0xe0, 0x00, 0x00, 0x00, 0x00, 0x00, 0x00, 0x00, 0x00, 0x00, 0x00, 0x00
};
// 'icons8-high-temperatures-20', 20x20px
const unsigned char epd_bitmap_icons8_high_temperatures_20 [] = {
	0x00, 0x60, 0x00, 0x00, 0xf0, 0x00, 0x00, 0x90, 0x00, 0x00, 0x90, 0x00, 0x00, 0x90, 0x00, 0x00, 
	0x90, 0x00, 0x00, 0x90, 0x00, 0x00, 0x90, 0x00, 0x01, 0x98, 0x00, 0x00, 0x90, 0x00, 0x03, 0x9c, 
	0x00, 0x00, 0x90, 0x00, 0x01, 0x98, 0x00, 0x00, 0x90, 0x00, 0x00, 0x90, 0x00, 0x11, 0x98, 0x00, 
	0x39, 0x09, 0xc0, 0x11, 0x98, 0x00, 0x00, 0xf0, 0x00, 0x00, 0x60, 0x00
};



/* USER CODE END 0 */



/**
  * @brief  The application entry point.
  * @retval int
  */
int main(void)
{
  /* USER CODE BEGIN 1 */

  /* USER CODE END 1 */

  /* MCU Configuration--------------------------------------------------------*/

  /* Reset of all peripherals, Initializes the Flash interface and the Systick. */
  HAL_Init();

  /* USER CODE BEGIN Init */

  /* USER CODE END Init */

  /* Configure the system clock */
  SystemClock_Config();

  /* USER CODE BEGIN SysInit */

  /* USER CODE END SysInit */

  /* Initialize all configured peripherals */
  MX_GPIO_Init();
  MX_I2C1_Init();
  /* USER CODE BEGIN 2 */
	SSD1306_Init();
	SSD1306_DrawBitmap(0,0,epd_bitmap_icons8_high_temperatures_20,20,20,1);
	//SSD1306_DrawBitmap(0,24,epd_bitmap_icons8_time_20__1_ ,20,20,1);
  SSD1306_GotoXY (24,2);
  SSD1306_Puts ("5", &Font_7x10, 1);
//  SSD1306_GotoXY (0, 30);
//  SSD1306_Puts ("pham", &Font_16x26, 1);
  SSD1306_UpdateScreen();
  //HAL_Delay (1000);

//  SSD1306_ScrollRight(0,7);
//  HAL_Delay(3000);
//  SSD1306_ScrollLeft(0,7);
//  HAL_Delay(3000);
//  SSD1306_Stopscroll();
//  SSD1306_Clear();
//  SSD1306_GotoXY (35,0);
//  SSD1306_Puts ("SCORE", &Font_11x18, 1);
  /* USER CODE END 2 */

  /* Infinite loop */
  /* USER CODE BEGIN WHILE */
  while (1)
  {
    /* USER CODE END WHILE */

    /* USER CODE BEGIN 3 */
//	for ( int x = 1; x <= 10000 ; x++ )
//	{
//		itoa(x, snum, 10);
//		SSD1306_GotoXY (0, 30);
//		SSD1306_Puts ("             ", &Font_16x26, 1);
//		SSD1306_UpdateScreen();
//		if(x < 10) {
//			SSD1306_GotoXY (53, 30);  // 1 DIGIT
//		}
//		else if (x < 100 ) {
//			SSD1306_GotoXY (45, 30);  // 2 DIGITS
//		}
//		else if (x < 1000 ) {
//			SSD1306_GotoXY (37, 30);  // 3 DIGITS
//		}
//		else {
//			SSD1306_GotoXY (30, 30);  // 4 DIGIS
//		}
//		SSD1306_Puts (snum, &Font_16x26, 1);
//		SSD1306_UpdateScreen();
//		HAL_Delay (500);
//	    }
	}
  /* USER CODE END 3 */
}

/**
  * @brief System Clock Configuration
  * @retval None
  */
void SystemClock_Config(void)
{
  RCC_OscInitTypeDef RCC_OscInitStruct = {0};
  RCC_ClkInitTypeDef RCC_ClkInitStruct = {0};

  /** Initializes the RCC Oscillators according to the specified parameters
  * in the RCC_OscInitTypeDef structure.
  */
  RCC_OscInitStruct.OscillatorType = RCC_OSCILLATORTYPE_HSE;
  RCC_OscInitStruct.HSEState = RCC_HSE_ON;
  RCC_OscInitStruct.HSEPredivValue = RCC_HSE_PREDIV_DIV1;
  RCC_OscInitStruct.HSIState = RCC_HSI_ON;
  RCC_OscInitStruct.PLL.PLLState = RCC_PLL_ON;
  RCC_OscInitStruct.PLL.PLLSource = RCC_PLLSOURCE_HSE;
  RCC_OscInitStruct.PLL.PLLMUL = RCC_PLL_MUL9;
  if (HAL_RCC_OscConfig(&RCC_OscInitStruct) != HAL_OK)
  {
    Error_Handler();
  }

  /** Initializes the CPU, AHB and APB buses clocks
  */
  RCC_ClkInitStruct.ClockType = RCC_CLOCKTYPE_HCLK|RCC_CLOCKTYPE_SYSCLK
                              |RCC_CLOCKTYPE_PCLK1|RCC_CLOCKTYPE_PCLK2;
  RCC_ClkInitStruct.SYSCLKSource = RCC_SYSCLKSOURCE_PLLCLK;
  RCC_ClkInitStruct.AHBCLKDivider = RCC_SYSCLK_DIV1;
  RCC_ClkInitStruct.APB1CLKDivider = RCC_HCLK_DIV2;
  RCC_ClkInitStruct.APB2CLKDivider = RCC_HCLK_DIV1;

  if (HAL_RCC_ClockConfig(&RCC_ClkInitStruct, FLASH_LATENCY_2) != HAL_OK)
  {
    Error_Handler();
  }
}

/**
  * @brief I2C1 Initialization Function
  * @param None
  * @retval None
  */
static void MX_I2C1_Init(void)
{

  /* USER CODE BEGIN I2C1_Init 0 */

  /* USER CODE END I2C1_Init 0 */

  /* USER CODE BEGIN I2C1_Init 1 */

  /* USER CODE END I2C1_Init 1 */
  hi2c1.Instance = I2C1;
  hi2c1.Init.ClockSpeed = 400000;
  hi2c1.Init.DutyCycle = I2C_DUTYCYCLE_2;
  hi2c1.Init.OwnAddress1 = 0;
  hi2c1.Init.AddressingMode = I2C_ADDRESSINGMODE_7BIT;
  hi2c1.Init.DualAddressMode = I2C_DUALADDRESS_DISABLE;
  hi2c1.Init.OwnAddress2 = 0;
  hi2c1.Init.GeneralCallMode = I2C_GENERALCALL_DISABLE;
  hi2c1.Init.NoStretchMode = I2C_NOSTRETCH_DISABLE;
  if (HAL_I2C_Init(&hi2c1) != HAL_OK)
  {
    Error_Handler();
  }
  /* USER CODE BEGIN I2C1_Init 2 */

  /* USER CODE END I2C1_Init 2 */

}

/**
  * @brief GPIO Initialization Function
  * @param None
  * @retval None
  */
static void MX_GPIO_Init(void)
{
/* USER CODE BEGIN MX_GPIO_Init_1 */
/* USER CODE END MX_GPIO_Init_1 */

  /* GPIO Ports Clock Enable */
  __HAL_RCC_GPIOD_CLK_ENABLE();
  __HAL_RCC_GPIOA_CLK_ENABLE();
  __HAL_RCC_GPIOB_CLK_ENABLE();

/* USER CODE BEGIN MX_GPIO_Init_2 */
/* USER CODE END MX_GPIO_Init_2 */
}

/* USER CODE BEGIN 4 */

/* USER CODE END 4 */

/**
  * @brief  This function is executed in case of error occurrence.
  * @retval None
  */
void Error_Handler(void)
{
  /* USER CODE BEGIN Error_Handler_Debug */
  /* User can add his own implementation to report the HAL error return state */
  __disable_irq();
  while (1)
  {
  }
  /* USER CODE END Error_Handler_Debug */
}

#ifdef  USE_FULL_ASSERT
/**
  * @brief  Reports the name of the source file and the source line number
  *         where the assert_param error has occurred.
  * @param  file: pointer to the source file name
  * @param  line: assert_param error line source number
  * @retval None
  */
void assert_failed(uint8_t *file, uint32_t line)
{
  /* USER CODE BEGIN 6 */
  /* User can add his own implementation to report the file name and line number,
     ex: printf("Wrong parameters value: file %s on line %d\r\n", file, line) */
  /* USER CODE END 6 */
}
#endif /* USE_FULL_ASSERT */
